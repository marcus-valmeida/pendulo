/* ssd1306.c — driver minimo do OLED SSD1306 (128x64) por I2C, STM32 HAL.
 * Fonte 7x10 (ASCII imprimivel 32..126). */
#include "ssd1306.h"
#include <string.h>

/* ---- Estado interno ---- */
static I2C_HandleTypeDef *ssd_i2c;
static uint8_t ssd_buffer[SSD1306_WIDTH * SSD1306_HEIGHT / 8];
static uint8_t cursor_x = 0;
static uint8_t cursor_y = 0;

/* ===================== Fonte 7x10 ===================== */
/* Cada caractere = 7 colunas de 10 bits (2 bytes por coluna, MSB primeiro).
   Subconjunto a partir do espaco (ASCII 32). Para economizar, incluimos
   um conjunto util: espaco, digitos, sinais, letras maiusculas e algumas
   minusculas comuns. Caracteres ausentes saem como espaco. */
typedef struct { uint8_t width; uint8_t height; const uint16_t *data; } FontDef;

/* Tabela compacta 7x10 (cada glifo: 7 uint16, bits 15..6 usados) */
static const uint16_t Font7x10[] = {
0x0000,0x0000,0x0000,0x0000,0x0000,0x0000,0x0000, // ' ' (32)
0x0000,0x0000,0x0000,0x4F80,0x0000,0x0000,0x0000, // '!'
0x0000,0x0700,0x0000,0x0000,0x0700,0x0000,0x0000, // '"'
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0x6100,0x5100,0x4900,0x4500,0x4300,0x0000,0x0000, // 'Z'
};

#define FONT_FIRST_CHAR  32     /* espaco */
#define FONT_LAST_CHAR   90     /* 'Z' */
#define FONT_W           7
#define FONT_H           10

/* ===================== Comunicacao I2C ===================== */
static void ssd_cmd(uint8_t c) {
    uint8_t d[2] = {0x00, c};   /* 0x00 = control byte: comando */
    HAL_I2C_Master_Transmit(ssd_i2c, SSD1306_I2C_ADDR, d, 2, 100);
}

/* ===================== API ===================== */
void SSD1306_Init(I2C_HandleTypeDef *hi2c) {
    ssd_i2c = hi2c;
    HAL_Delay(100);

    ssd_cmd(0xAE);              /* display off */
    ssd_cmd(0x20); ssd_cmd(0x00); /* memory mode: horizontal */
    ssd_cmd(0xB0);
    ssd_cmd(0xC0);             /* COM scan dir remap */
    ssd_cmd(0x00); ssd_cmd(0x10);
    ssd_cmd(0x40);             /* start line 0 */
    ssd_cmd(0x81); ssd_cmd(0xFF); /* contrast */
    ssd_cmd(0xA1);             /* segment remap */
    ssd_cmd(0xA6);             /* normal (nao invertido) */
    ssd_cmd(0xA8); ssd_cmd(0x3F); /* multiplex 1/64 */
    ssd_cmd(0xA4);             /* output follows RAM */
    ssd_cmd(0xD3); ssd_cmd(0x00); /* display offset 0 */
    ssd_cmd(0xD5); ssd_cmd(0x80); /* clock div */
    ssd_cmd(0xD9); ssd_cmd(0x22); /* pre-charge */
    ssd_cmd(0xDA); ssd_cmd(0x12); /* COM pins */
    ssd_cmd(0xDB); ssd_cmd(0x20); /* vcom detect */
    ssd_cmd(0x8D); ssd_cmd(0x14); /* charge pump on */
    ssd_cmd(0xAF);             /* display on */

    SSD1306_Clear();
    SSD1306_UpdateScreen();
}

void SSD1306_Clear(void) {
    memset(ssd_buffer, 0x00, sizeof(ssd_buffer));
    cursor_x = 0;
    cursor_y = 0;
}   

void SSD1306_SetCursor(uint8_t x, uint8_t y) {
    cursor_x = x;
    cursor_y = y;
}

/* Acende um pixel no buffer */
static void ssd_pixel(uint8_t x, uint8_t y) {
    if (x >= SSD1306_WIDTH || y >= SSD1306_HEIGHT) return;
    ssd_buffer[x + (y / 8) * SSD1306_WIDTH] |= (1 << (y & 7));
}

void SSD1306_WriteChar(char ch) {
    if (ch == '\n') { cursor_x = 0; cursor_y += FONT_H + 2; return; }
    if (ch < FONT_FIRST_CHAR || ch > FONT_LAST_CHAR) ch = ' ';

    const uint16_t *glyph = &Font7x10[(ch - FONT_FIRST_CHAR) * FONT_W];
    for (uint8_t col = 0; col < FONT_W; col++) {
        uint16_t line = glyph[col];
        for (uint8_t row = 0; row < FONT_H; row++) {
            if (line & (0x8000 >> row)) {
                ssd_pixel(cursor_x + col, cursor_y + row);
            }
        }
    }
    cursor_x += FONT_W + 1;
}

void SSD1306_WriteString(const char *str) {
    while (*str) {
        SSD1306_WriteChar(*str++);
    }
}

void SSD1306_UpdateScreen(void) {
    for (uint8_t page = 0; page < 8; page++) {
        ssd_cmd(0xB0 + page);
        ssd_cmd(0x00);
        ssd_cmd(0x10);
        uint8_t d[SSD1306_WIDTH + 1];
        d[0] = 0x40;  /* control byte: dados */
        memcpy(&d[1], &ssd_buffer[page * SSD1306_WIDTH], SSD1306_WIDTH);
        HAL_I2C_Master_Transmit(ssd_i2c, SSD1306_I2C_ADDR, d, SSD1306_WIDTH + 1, 100);
    }
}